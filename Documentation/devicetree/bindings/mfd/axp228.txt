## Documentation/devicetree/bindings/mfd/axp228.txt
```
X-Powers AXP228 Multi-Function Device

The X-Powers AXP228 is a multi-function device which includes voltage/current
regulators, real time clock, battery charging controller and several
other sub-blocks. It is interfaced using an I2C interface. Each sub-block
is addressed by the host system using different i2c slave address.

AXP228 additionally contains PMIC (with DCDC/LDO regulators), charger and Fuel Gauge.

Required properties:
- compatible : Must be "x-powers,axp228".
- reg : I2C slave address for the axp228 chip.
- nx,id : TBD

Board DTS Example:
	kernel/arch/arm/boot/dts/s5p4418-con_svma-common.dtsi
	#include <dt-bindings/interrupt-controller/irq.h>
	axp228@34 {
		compatible = "x-powers,axp228";
		reg = <0x34>;
		interrupt-parent = <&alive_0>;
		interrupts = <0x4 IRQ_TYPE_EDGE_FALLING>;
		nx,id = <0>;
		#include "s5p4418-con_svma-axp228.dtsi"
	};

AXP228 Regulator DTS Example:
	kernel/arch/arm/boot/dts/s5p4418-con_svma-axp228.dtsi
	regulators {
		VCC3P3_CORE:axp22_dcdc1 {
				nx,id = <AXP228_ID_DCDC1>;
				regulator-name = AXP228_DCDC1_NAME;
				regulator-min-microvolt = <AXP228_DCDC1_MIN>;
				regulator-max-microvolt = <AXP228_DCDC1_MAX>;
				regulator-always-on;
				regulator-boot-on;
				regulator-state-mem {
					regulator-off-in-suspend;
				};
			};

		VCC_ARM:axp22_dcdc2 {
				nx,id = <AXP228_ID_DCDC2>;
				regulator-name = AXP228_DCDC2_NAME;
				regulator-min-microvolt = <AXP228_DCDC2_MIN>;
				regulator-max-microvolt = <AXP228_DCDC2_MAX>;
				regulator-always-on;
				regulator-boot-on;
				regulator-ramp-delay = <1600>;
				regulator-state-mem {
					regulator-off-in-suspend;
				};
			};

		... ... ...

		VCC1P5_DDR:axp22_dcdc5 {
				nx,id = <AXP228_ID_DCDC5>;
				regulator-name = AXP228_DCDC5_NAME;
				regulator-min-microvolt = <AXP228_DCDC5_MIN>;
				regulator-max-microvolt = <AXP228_DCDC5_MAX>;
				regulator-always-on;
				regulator-boot-on;
				regulator-state-mem {
					regulator-on-in-suspend;
				};
			};

		VCC3P3_ALIVE:axp22_aldo1 {
				nx,id = <AXP228_ID_ALDO1>;
				regulator-name = AXP228_ALDO1_NAME;
				regulator-min-microvolt = <AXP228_ALDO1_MIN>;
				regulator-max-microvolt = <AXP228_ALDO1_MAX>;
				regulator-always-on;
				regulator-boot-on;
				regulator-state-mem {
					regulator-on-in-suspend;
				};
			};

		... ... ...

	};
```
